## config/west.yml
```yaml
#defaultの設定
# NOTE: zmk-pmw3610-driver は Zephyr 4.1.0 に統合されたため削除
manifest:
  remotes:
    - name: zmkfirmware
      url-base: https://github.com/zmkfirmware
    - name: caksoylar
      url-base: https://github.com/caksoylar
    - name: ImSota
      url-base: https://github.com/ImSota
  projects:
    - name: zmk
      remote: zmkfirmware
      revision: main
      import: app/west.yml
    - name: zmk-rgbled-widget
      remote: caksoylar
      revision: main
    - name: zmk-naginata
      remote: ImSota
      revision: main
  self:
    path: config
```
